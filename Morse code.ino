
int led = 13; // наш диод на 13 пине
int period = 200; // период мигания 200мс
char *letters[] = {".-","-...","-.-.","-..",".","..-.","--.","....","..",".---","-.-",".-..","--","-.","---",".--.","--.-",".-.","...","-","..-","...-",".--","-..-","-.--","--.."};
// выше выделили память под двумерный символьный массив, и  инициализировали его Азбукой Морзе в соответствии с алфавитом А, B, C...
// Эта функция выполнится один раз
void setup() {
  Serial.begin(9600); // скорость передачи данных через порт 9600 бод
  pinMode(led,OUTPUT); // установка 13 пина на выход
}

void loop() { // основная функция выполняется непрерывно
  char ch; // переменная для считывания символа введенного с клавиатуры
  if(Serial.available() > 0) // проверка есть ли что нибудь в буфере, функция Serial.available() возрвращает кол-во байт которые лежат в буфере
  {
    ch = Serial.read(); // считываем с порта символ в переменную
    if (ch >= 'a' && ch <= 'z') // проверка буква ли это
    {
      leter(letters[ch-'a']); // если да то вызываем функцию, она описана ниже, ch - 'a' даст нам число n, и в функцию передастся элемент под индексом n
    }
  }

}
void leter(char *let)
{
  int i = 0; // счетчик ссимволов 
  while (let[i]!=0) // цикл длится пака не закончится наша строка символов
  {
    simvol(let[i]); // передаем i-ый символ массива в функцию, которая определяет точка это или тире
    i++; // следующий символ
  }
  delay(period * 3); // пауза между символами 
}
void simvol(char dotor) // функция определяет точка это или тире, и делает соответствующую паузу
{
  digitalWrite(led,HIGH); // подаем на диод высокое напряжение (он загорается)
  if(dotor == '.')
  {
    delay(period); // если точка пауза 200ms
  }
  else
  {
    delay(period * 3); // если тире пауза 600ms
  }
  digitalWrite(led,LOW); // ставим низкое напряжение, диод гаснет
  delay(period); 
}

